## components/ts_hal/Kconfig
```kconfig
menu "TianShanOS HAL Configuration"

    config TS_HAL_MAX_PINS
        int "Maximum number of managed pins"
        default 48
        help
            Maximum number of pins that can be managed by the pin manager.

    config TS_HAL_MAX_GPIO_HANDLES
        int "Maximum GPIO handles"
        default 32
        help
            Maximum number of GPIO handles that can be created.

    config TS_HAL_MAX_PWM_HANDLES
        int "Maximum PWM handles"
        default 8
        help
            Maximum number of PWM handles that can be created.

    config TS_HAL_MAX_I2C_HANDLES
        int "Maximum I2C handles"
        default 4
        help
            Maximum number of I2C handles that can be created.

    config TS_HAL_MAX_SPI_HANDLES
        int "Maximum SPI handles"
        default 4
        help
            Maximum number of SPI handles that can be created.

    config TS_HAL_MAX_UART_HANDLES
        int "Maximum UART handles"
        default 3
        help
            Maximum number of UART handles that can be created.

    config TS_HAL_MAX_ADC_HANDLES
        int "Maximum ADC handles"
        default 8
        help
            Maximum number of ADC handles that can be created.

    config TS_HAL_PIN_CONFIG_PATH
        string "Default pin configuration file path"
        default "/sdcard/config/pins.json"
        help
            Default path for loading pin configuration from file.

    config TS_HAL_ENABLE_PIN_CONFLICT_CHECK
        bool "Enable pin conflict checking"
        default y
        help
            Enable runtime checking for pin conflicts.

    config TS_HAL_PWM_DEFAULT_FREQ
        int "Default PWM frequency (Hz)"
        default 25000
        help
            Default PWM frequency for fan control and other PWM outputs.

    config TS_HAL_PWM_DEFAULT_RESOLUTION
        int "Default PWM resolution (bits)"
        default 8
        range 1 14
        help
            Default PWM resolution in bits.

endmenu
```

## components/ts_https/Kconfig
```kconfig
menu "TianShanOS HTTPS Server"

    config TS_HTTPS_ENABLED
        bool "Enable HTTPS Server"
        default y
        help
            Enable the mTLS HTTPS server for secure API access.

    config TS_HTTPS_PORT
        int "HTTPS Server Port"
        default 443
        range 1 65535
        depends on TS_HTTPS_ENABLED
        help
            Port number for the HTTPS server.

    config TS_HTTPS_MAX_CLIENTS
        int "Maximum Concurrent Clients"
        default 3
        range 1 8
        depends on TS_HTTPS_ENABLED
        help
            Maximum number of concurrent HTTPS connections.
            Each connection uses ~40KB of memory.

    config TS_HTTPS_REQUIRE_CLIENT_CERT
        bool "Require Client Certificate (mTLS)"
        default y
        depends on TS_HTTPS_ENABLED
        help
            When enabled, clients must provide a valid certificate
            signed by the trusted CA. This enables mutual TLS (mTLS).

    config TS_HTTPS_CTRL_LISTEN_BACKLOG
        int "Connection Listen Backlog"
        default 5
        range 1 10
        depends on TS_HTTPS_ENABLED
        help
            TCP listen backlog size.

    config TS_HTTPS_SESSION_CACHE_SIZE
        int "TLS Session Cache Size"
        default 4
        range 0 16
        depends on TS_HTTPS_ENABLED
        help
            Number of TLS sessions to cache for session resumption.
            Set to 0 to disable session caching.

endmenu
```

## components/ts_led/Kconfig
```kconfig
menu "TianShanOS LED Configuration"

    config TS_LED_MAX_DEVICES
        int "Maximum LED devices"
        default 8
        range 1 16
        help
            Maximum number of LED devices that can be created.

    config TS_LED_MAX_LAYERS
        int "Maximum layers per device"
        default 8
        range 1 16
        help
            Maximum number of layers per LED device.

    config TS_LED_DEFAULT_BRIGHTNESS
        int "Default brightness"
        default 128
        range 0 255
        help
            Default brightness for new LED devices.

    config TS_LED_TASK_PRIORITY
        int "LED render task priority"
        default 5
        range 1 24
        help
            FreeRTOS priority for the LED render task.

    config TS_LED_TASK_STACK_SIZE
        int "LED render task stack size"
        default 4096
        range 2048 8192
        help
            Stack size for the LED render task.

    config TS_LED_REFRESH_RATE_HZ
        int "Default refresh rate (Hz)"
        default 60
        range 1 120
        help
            Default refresh rate in Hz for LED rendering.

    menu "Touch LED Settings"
        config TS_LED_TOUCH_COUNT
            int "Touch LED count"
            default 1
            range 1 256
            help
                Number of LEDs in the touch panel. RM01 has single indicator.

        config TS_LED_TOUCH_DEFAULT_BRIGHTNESS
            int "Touch LED default brightness"
            default 80
            range 0 255
    endmenu

    menu "Board LED Settings"
        config TS_LED_BOARD_COUNT
            int "Board LED count"
            default 28
            range 1 512
            help
                Number of LEDs on the board indicator strip. RM01 has 28 LEDs.

        config TS_LED_BOARD_DEFAULT_BRIGHTNESS
            int "Board LED default brightness"
            default 60
            range 0 255
    endmenu

    menu "Matrix LED Settings"
        config TS_LED_MATRIX_WIDTH
            int "Matrix width"
            default 32
            range 1 64

        config TS_LED_MATRIX_HEIGHT
            int "Matrix height"
            default 32
            range 1 64

        config TS_LED_MATRIX_DEFAULT_BRIGHTNESS
            int "Matrix default brightness"
            default 50
            range 0 255
    endmenu

    menu "Image Support"
        config TS_LED_ENABLE_BMP
            bool "Enable BMP image support"
            default y

        config TS_LED_ENABLE_PNG
            bool "Enable PNG image support"
            default y

        config TS_LED_ENABLE_JPG
            bool "Enable JPEG image support"
            default y

        config TS_LED_ENABLE_GIF
            bool "Enable GIF image support"
            default y
    endmenu

endmenu
```

## components/ts_security/Kconfig
```kconfig
menu "TianShanOS Security Configuration"

    config TS_SECURITY_ENABLE
        bool "Enable Security Module"
        default y

    config TS_SECURITY_KEY_STORAGE_NVS
        bool "Store keys in NVS"
        default y
        depends on TS_SECURITY_ENABLE

    config TS_SECURITY_MTLS_ENABLE
        bool "Enable mTLS Authentication"
        default y
        depends on TS_SECURITY_ENABLE

    config TS_SECURITY_TOKEN_EXPIRE_SEC
        int "Auth Token Expiration (seconds)"
        default 3600
        depends on TS_SECURITY_ENABLE

    config TS_SECURITY_MAX_SESSIONS
        int "Maximum Active Sessions"
        default 8
        depends on TS_SECURITY_ENABLE

    config TS_SECURITY_PERMISSION_LEVELS
        int "Number of Permission Levels"
        default 4
        depends on TS_SECURITY_ENABLE

endmenu
```

## components/ts_storage/Kconfig
```kconfig
menu "TianShanOS Storage Configuration"

    config TS_STORAGE_ENABLE_SPIFFS
        bool "Enable SPIFFS support"
        default y
        help
            Enable SPIFFS filesystem for internal storage.

    config TS_STORAGE_SPIFFS_MOUNT_POINT
        string "SPIFFS mount point"
        default "/spiffs"
        depends on TS_STORAGE_ENABLE_SPIFFS
        help
            Mount point for SPIFFS filesystem.

    config TS_STORAGE_SPIFFS_PARTITION
        string "SPIFFS partition label"
        default "storage"
        depends on TS_STORAGE_ENABLE_SPIFFS
        help
            Partition label for SPIFFS.

    config TS_STORAGE_SPIFFS_MAX_FILES
        int "Maximum SPIFFS open files"
        default 5
        range 1 20
        depends on TS_STORAGE_ENABLE_SPIFFS
        help
            Maximum number of simultaneously open SPIFFS files.

    config TS_STORAGE_ENABLE_SD
        bool "Enable SD card support"
        default y
        help
            Enable SD card filesystem support.

    config TS_STORAGE_SD_MOUNT_POINT
        string "SD card mount point"
        default "/sdcard"
        depends on TS_STORAGE_ENABLE_SD
        help
            Mount point for SD card.

    config TS_STORAGE_SD_MAX_FREQ_KHZ
        int "SD card maximum frequency (kHz)"
        default 20000
        range 400 40000
        depends on TS_STORAGE_ENABLE_SD
        help
            Maximum frequency for SD card communication.

    choice TS_STORAGE_SD_MODE
        prompt "SD card interface mode"
        default TS_STORAGE_SD_MODE_SDIO_4BIT
        depends on TS_STORAGE_ENABLE_SD
        help
            Select SD card interface mode.

        config TS_STORAGE_SD_MODE_SPI
            bool "SPI mode"
        config TS_STORAGE_SD_MODE_SDIO_1BIT
            bool "SDIO 1-bit mode"
        config TS_STORAGE_SD_MODE_SDIO_4BIT
            bool "SDIO 4-bit mode"
    endchoice

endmenu
```

## components/ts_webui/Kconfig
```kconfig
menu "TianShanOS WebUI Configuration"

    config TS_WEBUI_ENABLE
        bool "Enable WebUI"
        default y

    config TS_WEBUI_API_PREFIX
        string "API URL Prefix"
        default "/api/v1"
        depends on TS_WEBUI_ENABLE

    config TS_WEBUI_WS_ENABLE
        bool "Enable WebSocket"
        default y
        depends on TS_WEBUI_ENABLE

    config TS_WEBUI_WS_MAX_CLIENTS
        int "Max WebSocket Clients"
        default 8
        depends on TS_WEBUI_WS_ENABLE

    config TS_WEBUI_TERMINAL_OUTPUT_BUF_SIZE
        int "Terminal output buffer size (bytes)"
        default 32768
        range 4096 131072
        depends on TS_WEBUI_WS_ENABLE
        help
            Max output size for local console commands (e.g. ssh --help).
            32KB recommended when PSRAM is available.

    config TS_WEBUI_AUTH_REQUIRED
        bool "Require Authentication for API"
        default y
        depends on TS_WEBUI_ENABLE

    config TS_WEBUI_CORS_ENABLE
        bool "Enable CORS"
        default y
        depends on TS_WEBUI_ENABLE

    config TS_WEBUI_STATIC_PATH
        string "Static Files Path"
        default "/www"
        depends on TS_WEBUI_ENABLE

endmenu
```
