## Kconfig.projbuild
```kconfig
menu "TianShanOS Configuration"

    config TIANSHAN_OS_VERSION
        string "TianShanOS Version"
        default "0.1.0-dev"
        help
            Version string for TianShanOS.

    menu "Board Selection"
        choice TIANSHAN_BOARD
            prompt "Target board"
            default TIANSHAN_BOARD_RM01_ESP32S3
            help
                Select the target board.

            config TIANSHAN_BOARD_RM01_ESP32S3
                bool "RM01 with ESP32-S3"
                help
                    Rack Manager 01 board with ESP32-S3.

            config TIANSHAN_BOARD_RM01_ESP32P4
                bool "RM01 with ESP32-P4"
                help
                    Rack Manager 01 board with ESP32-P4.

            config TIANSHAN_BOARD_CUSTOM
                bool "Custom board"
                help
                    Custom board configuration.
        endchoice
    endmenu

    rsource "components/ts_core/ts_config/Kconfig"
    rsource "components/ts_core/ts_log/Kconfig"
    rsource "components/ts_core/ts_event/Kconfig"
    rsource "components/ts_core/ts_service/Kconfig"

endmenu
```

## components/ts_automation/Kconfig
```kconfig
menu "TianShanOS Automation Engine"

    config TS_AUTOMATION_ENABLED
        bool "Enable Automation Engine"
        default y
        help
            Enable the automation engine for data monitoring,
            rule-based actions, and LED display control.

    config TS_AUTOMATION_CONFIG_PATH
        string "Default config file path"
        default "/sdcard/config/automation.json"
        depends on TS_AUTOMATION_ENABLED
        help
            Default path for automation configuration file on SD card.

    config TS_AUTOMATION_MAX_SOURCES
        int "Maximum number of data sources"
        default 16
        range 4 32
        depends on TS_AUTOMATION_ENABLED
        help
            Maximum number of data sources (builtin + remote).

    config TS_AUTOMATION_MAX_RULES
        int "Maximum number of rules"
        default 32
        range 8 64
        depends on TS_AUTOMATION_ENABLED
        help
            Maximum number of automation rules.

    config TS_AUTOMATION_MAX_VARIABLES
        int "Maximum number of variables"
        default 128
        range 32 256
        depends on TS_AUTOMATION_ENABLED
        help
            Maximum number of variables in the variable store.

    config TS_AUTOMATION_TASK_STACK_SIZE
        int "Automation task stack size"
        default 8192
        range 4096 16384
        depends on TS_AUTOMATION_ENABLED
        help
            Stack size for the automation engine task.

    config TS_AUTOMATION_TASK_PRIORITY
        int "Automation task priority"
        default 5
        range 1 10
        depends on TS_AUTOMATION_ENABLED
        help
            Priority for the automation engine task.

endmenu
```

## components/ts_console/Kconfig
```kconfig
menu "TianShanOS Console Configuration"

    config TS_CONSOLE_MAX_LINE_LENGTH
        int "Maximum command line length"
        default 256
        range 64 1024
        help
            Maximum length of a command line input.

    config TS_CONSOLE_MAX_HISTORY
        int "Maximum history entries"
        default 50
        range 10 200
        help
            Maximum number of command history entries to store.

    config TS_CONSOLE_TASK_PRIORITY
        int "Console task priority"
        default 5
        range 1 24
        help
            FreeRTOS priority for the console task.

    config TS_CONSOLE_TASK_STACK_SIZE
        int "Console task stack size"
        default 8192
        range 4096 16384
        help
            Stack size for the console task in bytes.

    config TS_CONSOLE_DEFAULT_PROMPT
        string "Default console prompt"
        default "tianshan> "
        help
            Default prompt string displayed in the console.

    config TS_CONSOLE_ENABLE_COLORS
        bool "Enable colored output"
        default y
        help
            Enable ANSI color codes in console output.

    config TS_CONSOLE_HISTORY_FILE
        string "History file path"
        default "/sdcard/.console_history"
        help
            Path to save command history.

endmenu
```

## components/ts_core/ts_config/Kconfig
```kconfig
menu "TianShanOS Configuration Management"

    config TS_CONFIG_ENABLE
        bool "Enable Configuration Management"
        default y
        help
            Enable the TianShanOS configuration management system.

    config TS_CONFIG_MAX_KEY_LENGTH
        int "Maximum configuration key length"
        default 64
        range 16 256
        help
            Maximum length of configuration key names.

    config TS_CONFIG_MAX_VALUE_SIZE
        int "Maximum configuration value size"
        default 512
        range 64 4096
        help
            Maximum size of configuration values in bytes.

    config TS_CONFIG_MAX_LISTENERS
        int "Maximum configuration change listeners"
        default 16
        range 4 64
        help
            Maximum number of configuration change listeners that can be registered.

    config TS_CONFIG_NVS_NAMESPACE
        string "NVS namespace for configuration"
        default "ts_config"
        help
            The NVS namespace used to store configuration data.

    menu "Configuration Backends"
        config TS_CONFIG_NVS_BACKEND
            bool "Enable NVS backend"
            default y
            help
                Enable NVS (Non-Volatile Storage) as a configuration backend.

        config TS_CONFIG_FILE_BACKEND
            bool "Enable file backend"
            default y
            help
                Enable file system as a configuration backend.

        config TS_CONFIG_FILE_PATH
            string "Configuration file path"
            default "/sdcard/config"
            depends on TS_CONFIG_FILE_BACKEND
            help
                Default path for configuration files.

        config TS_CONFIG_FILE_FORMAT_JSON
            bool "Support JSON format"
            default y
            depends on TS_CONFIG_FILE_BACKEND
            help
                Enable JSON format support for configuration files.

    endmenu

    menu "Configuration Priorities"
        config TS_CONFIG_PRIORITY_CLI
            int "CLI configuration priority"
            default 100
            range 0 255
            help
                Priority for CLI-set configurations. Higher value = higher priority.

        config TS_CONFIG_PRIORITY_NVS
            int "NVS configuration priority"
            default 80
            range 0 255
            help
                Priority for NVS-stored configurations.

        config TS_CONFIG_PRIORITY_FILE
            int "File configuration priority"
            default 60
            range 0 255
            help
                Priority for file-based configurations.

        config TS_CONFIG_PRIORITY_DEFAULT
            int "Default configuration priority"
            default 0
            range 0 255
            help
                Priority for default configurations.
    endmenu

    config TS_CONFIG_AUTO_SAVE
        bool "Auto-save configuration changes"
        default y
        help
            Automatically save configuration changes to persistent storage.

    config TS_CONFIG_AUTO_SAVE_DELAY_MS
        int "Auto-save delay in milliseconds"
        default 1000
        range 100 10000
        depends on TS_CONFIG_AUTO_SAVE
        help
            Delay before auto-saving configuration changes.
            Multiple changes within this period will be batched.

    config TS_CONFIG_DEBUG
        bool "Enable configuration debug logging"
        default n
        help
            Enable detailed debug logging for configuration operations.

endmenu
```

## components/ts_core/ts_event/Kconfig
```kconfig
menu "TianShanOS Event System"

    config TS_EVENT_ENABLE
        bool "Enable TianShanOS Event System"
        default y
        help
            Enable the TianShanOS event bus system.

    config TS_EVENT_LOOP_TASK_PRIORITY
        int "Event loop task priority"
        default 5
        range 1 25
        help
            FreeRTOS priority for the event loop task.

    config TS_EVENT_LOOP_TASK_STACK_SIZE
        int "Event loop task stack size"
        default 4096
        range 2048 16384
        help
            Stack size for the event loop task in bytes.

    config TS_EVENT_QUEUE_SIZE
        int "Event queue size"
        default 32
        range 8 256
        help
            Maximum number of events that can be queued.

    config TS_EVENT_MAX_HANDLERS
        int "Maximum event handlers"
        default 64
        range 16 256
        help
            Maximum number of event handlers that can be registered.

    config TS_EVENT_MAX_EVENT_TYPES
        int "Maximum event types"
        default 64
        range 16 256
        help
            Maximum number of event types that can be defined.

    config TS_EVENT_DATA_MAX_SIZE
        int "Maximum event data size"
        default 256
        range 32 1024
        help
            Maximum size of event data in bytes.

    config TS_EVENT_ENABLE_STATS
        bool "Enable event statistics"
        default y
        help
            Enable collection of event statistics.

    config TS_EVENT_ENABLE_TRACING
        bool "Enable event tracing"
        default n
        help
            Enable detailed event tracing for debugging.

endmenu
```

## components/ts_core/ts_service/Kconfig
```kconfig
menu "TianShanOS Service Management"

    config TS_SERVICE_ENABLE
        bool "Enable TianShanOS Service Management"
        default y
        help
            Enable the TianShanOS service management system.

    config TS_SERVICE_MAX_SERVICES
        int "Maximum number of services"
        default 32
        range 8 128
        help
            Maximum number of services that can be registered.

    config TS_SERVICE_NAME_MAX_LENGTH
        int "Maximum service name length"
        default 32
        range 16 64
        help
            Maximum length of service names.

    config TS_SERVICE_MAX_DEPENDENCIES
        int "Maximum dependencies per service"
        default 8
        range 4 16
        help
            Maximum number of dependencies a service can have.

    config TS_SERVICE_STARTUP_TIMEOUT_MS
        int "Service startup timeout (ms)"
        default 30000
        range 5000 120000
        help
            Maximum time allowed for a service to start, in milliseconds.

    config TS_SERVICE_SHUTDOWN_TIMEOUT_MS
        int "Service shutdown timeout (ms)"
        default 10000
        range 1000 60000
        help
            Maximum time allowed for a service to stop, in milliseconds.

    menu "Startup Phases"
        
        config TS_SERVICE_PHASE_PLATFORM_PRIORITY
            int "Platform phase priority"
            default 10
            help
                Priority for platform initialization phase.

        config TS_SERVICE_PHASE_CORE_PRIORITY
            int "Core phase priority"
            default 20
            help
                Priority for core services phase.

        config TS_SERVICE_PHASE_HAL_PRIORITY
            int "HAL phase priority"
            default 30
            help
                Priority for hardware abstraction layer phase.

        config TS_SERVICE_PHASE_DRIVER_PRIORITY
            int "Driver phase priority"
            default 40
            help
                Priority for driver initialization phase.

        config TS_SERVICE_PHASE_NETWORK_PRIORITY
            int "Network phase priority"
            default 50
            help
                Priority for network services phase.

        config TS_SERVICE_PHASE_SECURITY_PRIORITY
            int "Security phase priority"
            default 60
            help
                Priority for security services phase.

        config TS_SERVICE_PHASE_SERVICE_PRIORITY
            int "Service phase priority"
            default 70
            help
                Priority for application services phase.

        config TS_SERVICE_PHASE_UI_PRIORITY
            int "UI phase priority"
            default 80
            help
                Priority for user interface services phase.

    endmenu

    config TS_SERVICE_ENABLE_WATCHDOG
        bool "Enable service watchdog"
        default y
        help
            Enable watchdog monitoring for services.

    config TS_SERVICE_WATCHDOG_TIMEOUT_MS
        int "Watchdog timeout (ms)"
        default 60000
        depends on TS_SERVICE_ENABLE_WATCHDOG
        help
            Watchdog timeout for unresponsive services.

    config TS_SERVICE_DEBUG
        bool "Enable service debug logging"
        default n
        help
            Enable detailed debug logging for service operations.

endmenu
```

## components/ts_drivers/Kconfig
```kconfig
menu "TianShanOS Drivers Configuration"

    config TS_DRIVERS_FAN_ENABLE
        bool "Enable Fan Control"
        default y
        help
            Enable fan control driver with PWM and temperature curves.

    config TS_DRIVERS_FAN_PWM_FREQ
        int "Fan PWM Frequency (Hz)"
        default 25000
        depends on TS_DRIVERS_FAN_ENABLE
        help
            PWM frequency for fan control. Default 25kHz for 4-pin fans.

    config TS_DRIVERS_FAN_TEMP_UPDATE_MS
        int "Temperature Update Interval (ms)"
        default 1000
        depends on TS_DRIVERS_FAN_ENABLE

    config TS_DRIVERS_POWER_ENABLE
        bool "Enable Power Monitor"
        default y
        help
            Enable power monitoring via ADC or UART power chips.

    config TS_DRIVERS_POWER_ADC_SAMPLES
        int "ADC Sample Count for Averaging"
        default 16
        depends on TS_DRIVERS_POWER_ENABLE

    config TS_DRIVERS_DEVICE_ENABLE
        bool "Enable Device Control (AGX/LPMU)"
        default y
        help
            Enable AGX and LPMU power control.

    config TS_DRIVERS_AGX_POWER_ON_DELAY_MS
        int "AGX Power On Delay (ms)"
        default 100
        depends on TS_DRIVERS_DEVICE_ENABLE

    config TS_DRIVERS_USB_MUX_ENABLE
        bool "Enable USB MUX Control"
        default y
        help
            Enable USB MUX switching between host and device modes.

endmenu
```
